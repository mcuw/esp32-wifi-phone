## main/Kconfig.projbuild
```kconfig
menu "Telefon: Firmware-Update (OTA)"

    config PHONE_OTA_MANIFEST_URL
        string "URL des Update-Manifests"
        default "https://github.com/mcuw/esp32-wifi-phone/releases/latest/download/ota.json"
        help
            JSON {"version":"v1.2.3","url":"https://.../c6_phone.bin"}, das die
            CI an jedes Release haengt. Eigene Builds (z. B. eine Pro-Version
            mit signierten Images) tragen hier ihre eigene Quelle ein.

    config PHONE_OTA_FIRST_CHECK_S
        int "Erste Pruefung nach dem Verbinden (s)"
        default 60

    config PHONE_OTA_CHECK_INTERVAL_H
        int "Pruefintervall (h)"
        default 24

    config PHONE_OTA_VERIFY_TIMEOUT_S
        int "Neue Firmware muss sich innerhalb von ... als gueltig melden (s)"
        default 300
        help
            Eine frisch installierte Firmware gilt erst als gueltig, wenn WLAN,
            mDNS und Signalisierung laufen (oder die Einrichtung gestartet ist).
            Gelingt das nicht in dieser Zeit, startet das Telefon neu und der
            Bootloader nimmt wieder die vorherige Firmware.

endmenu

menu "Telefon: Testfunktionen"

    config PHONE_TEST_AUTODIAL
        bool "Automatisch wählen (nur für Bench-Tests)"
        default n
        help
            Das Telefon ruft den ersten gefundenen Kontakt (oder den unter
            PHONE_TEST_AUTODIAL_PEER genannten) wiederholt an und legt nach
            einer festen Klingeldauer wieder auf. Damit lassen sich Anrufe auf
            ein Telefon im Sparmodus (iTWT) ohne Touch-Bedienung testen, siehe
            test/bench/ und Issue #5.

            Nur über sdkconfig.autodial in einem eigenen Build-Verzeichnis
            einschalten, nie in der Release-Firmware.

    if PHONE_TEST_AUTODIAL

        config PHONE_TEST_AUTODIAL_PEER
            string "Kontaktname (leer = erster gefundener)"
            default ""

        config PHONE_TEST_AUTODIAL_DELAY_S
            int "Wartezeit nach dem Finden des Kontakts (s)"
            default 45
            help
                Muss deutlich über IDLE_MS (20 s) liegen, damit der
                Angerufene beim ersten Anruf schon im iTWT schläft.

        config PHONE_TEST_AUTODIAL_RING_S
            int "Klingeldauer bis zum Auflegen (s)"
            default 30
            help
                Über 20 s prüft zusätzlich, dass der Angerufene nach einem
                unbeantworteten langen Klingeln wieder in den Sparmodus geht.

        config PHONE_TEST_AUTODIAL_PAUSE_S
            int "Pause zwischen zwei Anrufen (s)"
            default 50

        config PHONE_TEST_AUTODIAL_ROUNDS
            int "Anzahl Anrufe (0 = endlos)"
            default 2

    endif

    config PHONE_TEST_OTA
        bool "OTA ohne Bestaetigung installieren (nur fuer Bench-Tests)"
        default n
        help
            Ein gefundenes Update wird ohne Tippen am Display installiert, und
            das Manifest darf ueber http:// kommen (Firmware-Ablage des
            Testbench). Nur ueber sdkconfig.otatest, siehe test/bench/test_ota.py.

    config PHONE_TEST_OTA_NEVER_VALID
        bool "Firmware meldet sich nie als gueltig (defektes Image fuer den Rollback-Test)"
        depends on PHONE_TEST_OTA
        default n

endmenu
```
